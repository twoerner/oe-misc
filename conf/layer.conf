## conf/layer.conf
```bitbake
BBPATH := "${BBPATH}:${LAYERDIR}"

BBFILES := "${BBFILES} ${LAYERDIR}/recipes-*/*/*.bb \
	${LAYERDIR}/recipes-*/*/*.bbappend"

BBFILE_COLLECTIONS += "trevor"
BBFILE_PATTERN_trevor := "^${LAYERDIR}/"
BBFILE_PRIORITY_trevor = "6"
```
